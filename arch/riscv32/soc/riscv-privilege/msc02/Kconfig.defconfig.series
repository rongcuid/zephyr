## arch/riscv32/soc/riscv-privilege/msc02/Kconfig.defconfig.series
```kconfig
if SOC_SERIES_RISCV32_MSC02

config SOC_SERIES
	string
	default "msc02"

config SYS_CLOCK_HW_CYCLES_PER_SEC
	int
	default 12000000

config RISCV_SOC_INTERRUPT_INIT
	bool
	default n

config RISCV_HAS_CPU_IDLE
	bool
	default n

config RISCV_HAS_PLIC
	bool
	default n

config NUM_IRQS
	int
	default 17

config XIP
	bool
	default y

config RISCV_ROM_BASE_ADDR
	hex
	default 0x00000000

config RISCV_ROM_SIZE
	hex
	default 0x3C00

config RISCV_RAM_BASE_ADDR
	hex
	default	0x10000000

config RISCV_RAM_SIZE
	hex
	default 0x8000

endif # SOC_SERIES_RISCV32_MSC02
```

## arch/riscv32/soc/riscv-privilege/msc02/Kconfig.series
```kconfig
# Kconfig - RISCV32_MIV implementation
#
# Copyright (c) 2018 Antmicro <www.antmicro.com>
#

config SOC_SERIES_RISCV32_MSC02
	bool "MadScientistCarl implementation 02"
	depends on RISCV32
	select SOC_FAMILY_RISCV_PRIVILEGE
	help
	Enable support for MSC 02
```

## arch/riscv32/soc/riscv-privilege/msc02/Kconfig.soc
```kconfig
# Kconfig - RISCV32_MIV configuration options
#
# Copyright (c) 2018 Antmicro <www.antmicro.com>
#

choice
prompt "MadScientistCarl Implementation 02"
depends on SOC_SERIES_RISCV32_MSC02

config SOC_RISCV32_MSC02
	bool "MadScientistCarl Implementation 02"
	select ATOMIC_OPERATIONS_C

endchoice
```

## boards/riscv32/msc02_icestorm/Kconfig.board
```kconfig
config BOARD_MSC02_ICESTORM
	bool "MadScientistCarl implementation 02 on ICESTORM"
	depends on SOC_RISCV32_MSC02
```

## boards/riscv32/msc02_icestorm/msc02_icestorm_defconfig
```kconfig
CONFIG_RISCV32=y
CONFIG_SOC_SERIES_RISCV32_MSC02=y
CONFIG_SOC_RISCV32_MSC02=y
CONFIG_BOARD_MSC02_ICESTORM=y
CONFIG_CONSOLE=y
CONFIG_RAM_CONSOLE=y
CONFIG_SERIAL=n
CONFIG_PLIC=n
CONFIG_RISCV_MACHINE_TIMER=y
CONFIG_GPIO=n
CONFIG_XIP=y
```
